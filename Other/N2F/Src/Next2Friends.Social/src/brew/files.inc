OBJS = \
$(OBJDIR)\ApplicationManager.o\
$(OBJDIR)\Next2Friends.o\
$(OBJDIR)\GUIButton.o\
$(OBJDIR)\GUIMenuItem.o\
$(OBJDIR)\GUIPopUp.o\
$(OBJDIR)\PopUpDelegate.o\
$(OBJDIR)\GUIPopUpItem.o\
$(OBJDIR)\TextBalancer.o\
$(OBJDIR)\StringWrapper.o\
$(OBJDIR)\ScreenGo.o\
$(OBJDIR)\GUIEditPassword.o\
$(OBJDIR)\GUIEditText.o\
$(OBJDIR)\GUIInputText.o\
$(OBJDIR)\ScreenCredentials.o\
$(OBJDIR)\IndicatorDelegate.o\
$(OBJDIR)\GUIIndicator.o\
$(OBJDIR)\GUICapsIndicator.o\
$(OBJDIR)\ScreenRemindPassword.o\
$(OBJDIR)\GUITabList.o\
$(OBJDIR)\ScreenAsk.o\
$(OBJDIR)\GUISelector.o\
$(OBJDIR)\GUIEditMultiString.o\
$(OBJDIR)\GUIMultiString.o\
$(OBJDIR)\ScreenTemplates.o\
$(OBJDIR)\N2FMessage.o\
$(OBJDIR)\N2FDraftsManager.o\
$(OBJDIR)\N2FMessageOwner.o\
$(OBJDIR)\ScreenDrafts.o\
$(OBJDIR)\ApplicationManager.o\
$(OBJDIR)\GUISystem.o\
$(OBJDIR)\GUIControl.o\
$(OBJDIR)\GUIControlContainer.o\
$(OBJDIR)\GUILayoutBox.o\
$(OBJDIR)\GUIListView.o\
$(OBJDIR)\VList.o\
$(OBJDIR)\GUIEventDispatcher.o\
$(OBJDIR)\GUISkinLocal.o\
$(OBJDIR)\GUIScrollBar.o\
$(OBJDIR)\BaseScreen.o\
$(OBJDIR)\ScreenTitle.o\
$(OBJDIR)\GUIImage.o\
$(OBJDIR)\GUIHeader.o\
$(OBJDIR)\GUIText.o\
$(OBJDIR)\GUIFooter.o\
$(OBJDIR)\ScreenMainMenu.o\
$(OBJDIR)\ScreenAttachFromFile.o\
$(OBJDIR)\ScreenViewPhoto.o\
$(OBJDIR)\ScreenCamera.o\
$(OBJDIR)\GUIItemsList.o\
$(OBJDIR)\SurfacesPool.o\
$(OBJDIR)\GUIPhotoImage.o\





